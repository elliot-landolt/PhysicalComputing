/*
Box Alarm
By: Elliot Landolt and Zach Wrubel
*/
int alarmPin = 2; // alarm
int photoPin = A0; // photoresistor
int ledPin = 6; // green
int ledPin2 = 5; // red
int ledState = LOW; // Led state
unsigned long previousMillis = 0; // time since led flashed
long interval = 1000; // the delay
int val = 0;

void setup() {
    pinMode(alarmPin, OUTPUT);
    pinMode(photoPin, INPUT);
    pinMode(ledPin, OUTPUT);
    pinMode(ledPin2, OUTPUT);
    Serial.begin(9600);
}

void loop() {
  // DELAY W/O BLINK
  val = analogRead(photoPin);
  unsigned long currentMillis = millis();
  Serial.println(val);
  digitalWrite(ledPin2, LOW);
  if (currentMillis - previousMillis >= interval) {
    // save the last time you blinked the LED
    previousMillis = currentMillis;
    // if the LED is off turn it on and vice-versa:
    if (ledState == LOW and val < 300) {
        ledState = HIGH;
    }
    else {
        ledState = LOW;
    }
  }
    // set the LED with the ledState of the variable:
  digitalWrite(ledPin, ledState);
  
  // PHOTORESISTOR CODE
  if (val >= 300){
    tone(alarmPin, 440);
    digitalWrite(ledPin, LOW);
    digitalWrite(ledPin2, HIGH);
    delay(1000);
    tone(alarmPin, 880, 1000);
  }  
}