/*
Final Project
By: Elliot Landolt
*/

// Library Setup
#include <Keypad.h>
#include <LiquidCrystal_I2C.h>
#include <Wire.h>
#include <Tone.h>

// Speaker Setup
int spkPin = 10;

//Mode Setup
bool menuMode = LOW; // mp3 mode
bool pianoMode = LOW;
bool menu_mode_run = HIGH;

// BLINK W/O DELAY SETUP
unsigned long previousMillis = 0;
const long interval = 2000; // 2 seconds


//KEYPAD SETUP
const byte ROWS = 4; //four rows
const byte COLS = 4; //four columns
char keys[ROWS][COLS] = {
  {'1','2','3','A'},
  {'4','5','6','B'},
  {'7','8','9','C'},
  {'*','0','#','D'}
};
byte rowPins[ROWS] = {5, 4, 3, 2}; //connect to the row pinouts of the keypad
byte colPins[COLS] = {9, 8, 7, 6}; //connect to the column pinouts of the keypad
Keypad keypad = Keypad( makeKeymap(keys), rowPins, colPins, ROWS, COLS );

// SONG LIST SETUP
char list_string[9][18] = {"1. The Simpsons ","2. Indiana Jones","3. Take On Me   ","4.TheEntertainer","5. Tom Cruise MI","6. X-Files      ","7. 20th Fox     ","8. Barbie Girl  ", "9. Star Wars    "};
int i = 0;

// LCD Setup
LiquidCrystal_I2C lcd(0x27,16,2); // call library lcd(set LCD address, 16 width, 2 lines display)

// RTTL Setup

Tone tone1;

#define OCTAVE_OFFSET 0

int notes[] = { 0,
NOTE_C4, NOTE_CS4, NOTE_D4, NOTE_DS4, NOTE_E4, NOTE_F4, NOTE_FS4, NOTE_G4, NOTE_GS4, NOTE_A4, NOTE_AS4, NOTE_B4,
NOTE_C5, NOTE_CS5, NOTE_D5, NOTE_DS5, NOTE_E5, NOTE_F5, NOTE_FS5, NOTE_G5, NOTE_GS5, NOTE_A5, NOTE_AS5, NOTE_B5,
NOTE_C6, NOTE_CS6, NOTE_D6, NOTE_DS6, NOTE_E6, NOTE_F6, NOTE_FS6, NOTE_G6, NOTE_GS6, NOTE_A6, NOTE_AS6, NOTE_B6,
NOTE_C7, NOTE_CS7, NOTE_D7, NOTE_DS7, NOTE_E7, NOTE_F7, NOTE_FS7, NOTE_G7, NOTE_GS7, NOTE_A7, NOTE_AS7, NOTE_B7
};

// RTTL SONGS
char *simpsons = "The Simpsons:d=4,o=5,b=160:c.6,e6,f#6,8a6,g.6,e6,c6,8a,8f#,8f#,8f#,2g,8p,8p,8f#,8f#,8f#,8g,a#.,8c6,8c6,8c6,c6";
char *indiana = "Indiana:d=4,o=5,b=250:e,8p,8f,8g,8p,1c6,8p.,d,8p,8e,1f,p.,g,8p,8a,8b,8p,1f6,p,a,8p,8b,2c6,2d6,2e6,e,8p,8f,8g,8p,1c6,p,d6,8p,8e6,1f.6,g,8p,8g,e.6,8p,d6,8p,8g,e.6,8p,d6,8p,8g,f.6,8p,e6,8p,8d6,2c6";
char *take_on_me = "TakeOnMe:d=4,o=4,b=160:8f#5,8f#5,8f#5,8d5,8p,8b,8p,8e5,8p,8e5,8p,8e5,8g#5,8g#5,8a5,8b5,8a5,8a5,8a5,8e5,8p,8d5,8p,8f#5,8p,8f#5,8p,8f#5,8e5,8e5,8f#5,8e5,8f#5,8f#5,8f#5,8d5,8p,8b,8p,8e5,8p,8e5,8p,8e5,8g#5,8g#5,8a5,8b5,8a5,8a5,8a5,8e5,8p,8d5,8p,8f#5,8p,8f#5,8p,8f#5,8e5,8e5";
char *entertainer = "Entertainer:d=4,o=5,b=140:8d,8d#,8e,c6,8e,c6,8e,2c.6,8c6,8d6,8d#6,8e6,8c6,8d6,e6,8b,d6,2c6,p,8d,8d#,8e,c6,8e,c6,8e,2c.6,8p,8a,8g,8f#,8a,8c6,e6,8d6,8c6,8a,2d6";
char *xfiles = "Xfiles:d=4,o=5,b=125:e,b,a,b,d6,2b.,1p,e,b,a,b,e6,2b.,1p,g6,f#6,e6,d6,e6,2b.,1p,g6,f#6,e6,d6,f#6,2b.,1p,e,b,a,b,d6,2b.,1p,e,b,a,b,e6,2b.,1p,e6,2b.";
char *fox = "20thCenFox:d=16,o=5,b=140:b,8p,b,b,2b,p,c6,32p,b,32p,c6,32p,b,32p,c6,32p,b,8p,b,b,b,32p,b,32p,b,32p,b,32p,b,32p,b,32p,b,32p,g#,32p,a,32p,b,8p,b,b,2b,4p,8e,8g#,8b,1c#6,8f#,8a,8c#6,1e6,8a,8c#6,8e6,1e6,8b,8g#,8a,2b";
char *barbie_girl = "BarbieGirl:d=4,o=5,b=125:8g#,8e,8g#,8c#6,a,p,8f#,8d#,8f#,8b,g#,8f#,8e,p,8e,8c#,f#,c#,p,8f#,8e,g#,f#";
char *mission_imp = "MissionImp:d=16,o=6,b=95:32d,32d#,32d,32d#,32d,32d#,32d,32d#,32d,32d,32d#,32e,32f,32f#,32g,g,8p,g,8p,a#,p,c7,p,g,8p,g,8p,f,p,f#,p,g,8p,g,8p,a#,p,c7,p,g,8p,g,8p,f,p,f#,p,a#,g,2d,32p,a#,g,2c#,32p,a#,g,2c,a#5,8c,2p,32p,a#5,g5,2f#,32p,a#5,g5,2f,32p,a#5,g5,2e,d#,8d";
char *star_wars = "StarWars:d=4,o=5,b=45:32p,32f#,32f#,32f#,8b.,8f#.6,32e6,32d#6,32c#6,8b.6,16f#.6,32e6,32d#6,32c#6,8b.6,16f#.6,32e6,32d#6,32e6,8c#.6,32f#,32f#,32f#,8b.,8f#.6,32e6,32d#6,32c#6,8b.6,16f#.6,32e6,32d#6,32c#6,8b.6,16f#.6,32e6,32d#6,32e6,8c#6";

void setup(){
   Serial.begin(9600);
   //LCD Setup
   lcd.init(); // initialize the LCD
   lcd.backlight(); // turns backlight on
   // Piezo Setup
   pinMode(spkPin, OUTPUT);
   // RTTTL SETUP
   tone1.begin(spkPin);
   // MAIN MENU
   main_menu();
}
// RTTL SONG PLAYING METHOD
#define isdigit(n) (n >= '0' && n <= '9')



//Song Mode
void menu_mode(){
  lcd.setCursor(0,0);
  lcd.print("Welcome to");
  lcd.setCursor(0,1);
  lcd.print("MP3 Mode");
  delay(2000);
  menu_mode_run = LOW;
}

// MAIN MENU
void main_menu(){
  tone1.stop();
  lcd.clear();
  lcd.setCursor(0,0);
  lcd.print("Welcome to");
  lcd.setCursor(0,1);
  lcd.print("Keypad MP3");
  delay(3000);
  lcd.clear();
  lcd.setCursor(0,0);
  lcd.print("Press '*'");
  lcd.setCursor(0,1);
  lcd.print("for Piano Mode");
  delay(3000);
  lcd.clear();
  lcd.setCursor(0,0);
  lcd.print("Press '#'");
  lcd.setCursor(0,1);
  lcd.print("for MP3 Mode");
  delay(3000);
  lcd.clear();
}
// SONG LIST

void song_list(){
  unsigned long currentMillis = millis();
  if (currentMillis - previousMillis >= interval) {
    // save the last time you drew the song list
    previousMillis = currentMillis;
    lcd.clear();
    lcd.setCursor(0,0);
    lcd.print("Song List:");
    lcd.setCursor(0,1);
    lcd.print(list_string[i]);
    i++;
  }
  if (i>9){
    i = 0;
  } 
  
}

void loop(void){
  char key = keypad.getKey();
  if (key == '*' && menuMode == LOW){
    pianoMode = !pianoMode;
    tone1.stop();
    lcd.clear();
  }
  if (key == '#' && pianoMode == LOW){
    menuMode = !menuMode;
  }
  if (menuMode == LOW && pianoMode == LOW && main_menu == LOW){
    lcd.setCursor(0,0);
    lcd.print("Piano Mode: '*'");
    lcd.setCursor(0,1);
    lcd.print("MP3 Mode: '#'");
  }
  
  // PIANO MODE
  if (pianoMode == HIGH){
    lcd.setCursor(0,0);
    lcd.print("Piano Mode");
    lcd.setCursor(0,1);
    lcd.print("Press * to exit");
    if (key == '1' && keypad.getState() == PRESSED){
      tone1.play(261.63);
    }
    if (key == '2' && keypad.getState() == PRESSED){
      tone1.play(293.66);
    }
    if (key == '3' && keypad.getState() == PRESSED){
      tone1.play(329.63);
    }
    if (key == '4' && keypad.getState() == PRESSED){
      tone1.play(349.23);
    }
    if (key == '5' && keypad.getState() == PRESSED){
      tone1.play(392.00);
    }
    if (key == '6' && keypad.getState() == PRESSED){
      tone1.play(440.00);
    }
    if (key == '7' && keypad.getState() == PRESSED){
      tone1.play(493.88);
    }
    if (key == '8' && keypad.getState() == PRESSED){
      tone1.play(523.25);
    }
    if (key == '0' && keypad.getState() == PRESSED){
      tone1.stop();
    }
  }
  
  // MENU MODE
  if (menuMode == HIGH){
    if (menu_mode_run == HIGH){
      menu_mode();
      menu_mode_run = LOW;
    }
    else{
      Serial.println(menu_mode_run);
      song_list();
    }
    if (key == '1'){
      lcd.clear();
      lcd.setCursor(0,0);
      lcd.print("Playing");
      lcd.setCursor(0,1);
      lcd.print("The Simpsons");
      play_rtttl(simpsons);
      lcd.clear();
    }
    if (key == '2'){
      lcd.clear();
      lcd.setCursor(0,0);
      lcd.print("Playing");
      lcd.setCursor(0,1);
      lcd.print("Indiana Jones");
      play_rtttl(indiana);
      lcd.clear();
    }
    if (key == '3'){
      lcd.clear();
      lcd.setCursor(0,0);
      lcd.print("Playing");
      lcd.setCursor(0,1);
      lcd.print("Take on Me");
      play_rtttl(take_on_me);
      lcd.clear();
    }
    if (key == '4'){
      lcd.clear();
      lcd.setCursor(0,0);
      lcd.print("Playing");
      lcd.setCursor(0,1);
      lcd.print("The Entertainer");
      play_rtttl(entertainer);
      lcd.clear();
    }
    if (key == '5'){
      lcd.clear();
      lcd.setCursor(0,0);
      lcd.print("Playing");
      lcd.setCursor(0,1);
      lcd.print("Tom Cruise MI");
      play_rtttl(mission_imp);
      lcd.clear();
    }
    if (key == '6'){
      lcd.clear();
      lcd.setCursor(0,0);
      lcd.print("Playing");
      lcd.setCursor(0,1);
      lcd.print("X-Files");
      play_rtttl(xfiles);
      lcd.clear();
    }
    
    if (key == '7'){
      lcd.clear();
      lcd.setCursor(0,0);
      lcd.print("Playing");
      lcd.setCursor(0,1);
      lcd.print("20th Fox");
      play_rtttl(fox);
      lcd.clear();
    }
    if (key == '8'){
      lcd.clear();
      lcd.setCursor(0,0);
      lcd.print("Playing");
      lcd.setCursor(0,1);
      lcd.print("Barbie Girl");
      play_rtttl(barbie_girl);
      lcd.clear();
    }
    if (key == '9'){
      lcd.clear();
      lcd.setCursor(0,0);
      lcd.print("Playing");
      lcd.setCursor(0,1);
      lcd.print("Star Wars");
      play_rtttl(star_wars);
      lcd.clear();
    }
  }  
}