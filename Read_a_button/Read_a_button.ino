/*
Read a button
*/

int buttonPin = 2;
int buttonState = LOW; // is the button currently pushed
int ledState = LOW;
void setup() {
  pinMode(buttonPin, INPUT);
  Serial.begin(9600);
  pinMode(6, OUTPUT);
  pinMode(7, OUTPUT);
  digitalWrite(6, ledState);
  digitalWrite(7, ledState);
}

void loop() {
  /*
  Serial.println(digitalRead(buttonPin));
  int x = digitalRead(buttonPin);
  if (x == 1){
    Serial.println("Take your finger off the button");
  }
  */
  if (debounceButton(buttonState) == HIGH && buttonState == LOW){
    // code only runs once when button is pressed down
    buttonState = HIGH;
    ledState = !ledState; // not the led state (High set to Low)
   
  }
  
  else if (debounceButton(buttonState)) == LOW && buttonState == HIGH){
    // code only runs once when button is released
    buttonState = LOW;
  }
  digitalWrite(6, ledState);
  digitalWrite(7, !ledState);
}
 bool debounceButton(bool state)
{
  bool stateNow = digitalRead(buttonPin);
  if (state != stateNow){
    delay(10);
    stateNow = digitalRead(buttonPin);
    
  }
  return stateNow;
  
}
