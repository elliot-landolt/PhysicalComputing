#include <Wire.h>
#include <LiquidCrystal_I2C.h>
/*
Magic 8Ball
By: Elliot Landolt
11-7-18
*/

int x = 0;
int tiltPin = 9;
int tiltState = HIGH;

char responses[15][16] = {"Yes", "No", "100 Percent Yes", "Never", "Maybe", "Who Knows", "You tell me", "Without a doubt", "Outlook not good", "Always", "God says so", "Ask Donald", "Ask Hillary", "Ask Mr. Lee", "I don't know"};

LiquidCrystal_I2C lcd(0x27,16,2); // call library lcd(set LCD address, 16 width, 2 lines display)
void setup() {
  lcd.init(); // initialize the LCD
  lcd.backlight(); // turns backlight on
  lcd.setCursor(0,0); // start of first line
  lcd.print("Welcome to 8Ball");
  delay(3000);
  lcd.clear(); // clear
  lcd.print("Ask 1 question");
  lcd.setCursor(0,1); // start of the second line
  lcd.print("And get 1 answer");
  delay(5000);
  lcd.clear();
  pinMode(tiltPin, INPUT);
  Serial.begin(9600);
  x = random(1, 16);
}

void loop() {
  
  if (debounceTilt(tiltState) == LOW && tiltState == HIGH){
    // code only runs once when tilt is tilted
    lcd.clear();
    randomSeed(analogRead(A0));
    tiltState = LOW;
    lcd.print(responses[random(15)]);
  }
  else if (debounceTilt(tiltState) == HIGH && tiltState == LOW){
    // code only runs once when tilt is released
    tiltState = HIGH;
  }
  
}

// Debounce
bool debounceTilt(bool state)
{
  bool stateNow = digitalRead(tiltPin);
  if (state != stateNow){
    delay(1000);
    stateNow = digitalRead(tiltPin);
    
  }
  return stateNow;
} 
