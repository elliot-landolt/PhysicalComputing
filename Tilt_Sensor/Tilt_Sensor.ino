// Wire - Version: Latest 
#include <Wire.h>

// LiquidCrystal I2C - Version: Latest 
#include <LiquidCrystal_I2C.h>

/*
Tilt Sensor
*/

int tiltPin = 9;
int tiltState = LOW;

LiquidCrystal_I2C lcd(0x27,16,2); // call library lcd(set LCD address, 16 width, 2 lines display)
void setup() {
  lcd.init(); // initialize the LCD
  lcd.backlight(); // turns backlight on
  pinMode(tiltPin, INPUT);
  Serial.begin(9600);
}

void loop() {
  
  if (debounceTilt(tiltState) == HIGH && tiltState == LOW){
    // code only runs once when tilt is tilted
    tiltState = HIGH;
    randomSeed(analogRead(A3));
    lcd.print(random(1, 7));
  }
  else if (debounceTilt(tiltState) == LOW && tiltState == HIGH){
    // code only runs once when tilt is released
    tiltState = LOW;
  }
  
  
  
  
}
 
 
 bool debounceTilt(bool state)
{
  bool stateNow = digitalRead(tiltPin);
  if (state != stateNow){
    delay(1000);
    stateNow = digitalRead(tiltPin);
    
  }
  return stateNow;
} 
